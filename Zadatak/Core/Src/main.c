/* USER CODE BEGIN Header */
/**
  ******************************************************************************
  * @file           : main.c
  * @brief          : Main program body
  ******************************************************************************
  * @attention
  *
  * Copyright (c) 2021 STMicroelectronics.
  * All rights reserved.
  *
  * This software is licensed under terms that can be found in the LICENSE file
  * in the root directory of this software component.
  * If no LICENSE file comes with this software, it is provided AS-IS.
  *
  ******************************************************************************
  */
/* USER CODE END Header */
/* Includes ------------------------------------------------------------------*/
#include "main.h"
#include "i2c.h"
#include "i2s.h"
#include "usart.h"
#include "gpio.h"

/* Private includes ----------------------------------------------------------*/
/* USER CODE BEGIN Includes */
# include <stdlib.h>
# include "audio.h"
#include <time.h>
#include <string.h>
/* USER CODE END Includes */

/* Private typedef -----------------------------------------------------------*/
/* USER CODE BEGIN PTD */

/* USER CODE END PTD */

/* Private define ------------------------------------------------------------*/
/* USER CODE BEGIN PD */
#define TonC 364
#define TonCs 344
#define TonD 324
#define TonDs 306
#define TonE 289
#define TonF 273
#define TonFs 258
#define TonG 243
#define TonGs 230
#define TonA 217
#define TonAs 205
#define TonH 193


#define LOOPNUM 1000
/* USER CODE END PD */

/* Private macro -------------------------------------------------------------*/
/* USER CODE BEGIN PM */

/* USER CODE END PM */

/* Private variables ---------------------------------------------------------*/

/* USER CODE BEGIN PV */
char RX_BUFFER [ BUFSIZE ];
int RX_BUFFER_HEAD , RX_BUFFER_TAIL ;
uint8_t rx_data ;
const char *keys = "awsedftgzhuj";

uint16_t poljeC[TonC] = {1024, 1042, 1059, 1077, 1095, 1113, 1130, 1148, 1165, 1183, 1200, 1218, 1235,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 1006, 1024};
uint16_t poljeCs[TonCs] = {1024, 1043, 1062, 1080, 1099, 1118, 1136, 1155, 1174, 1192, 1211, 1229, 1247,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 1,
		2, 4, 6, 8, 10, 13, 16, 20, 24, 28, 32, 37,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 260,
		272, 285, 298, 312, 325, 339, 353, 367, 382, 397, 412, 427, 442, 458, 473, 489, 505, 522, 538, 555, 571, 588, 605, 622, 640, 657, 675, 692, 710, 728, 746, 764,
		782, 801, 819, 837, 856, 874, 893, 912, 930, 949, 968, 986, 1005, 1024};
uint16_t poljeD[TonD] = {1024, 1044, 1064, 1084, 1104, 1123, 1143, 1163, 1183, 1202, 1222, 1241, 1261,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 71,
		64, 57, 51, 45, 39, 34, 29, 24, 20, 17, 13, 10,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 1004, 1024};
uint16_t poljeDs[TonDs] = {1024, 1045, 1066, 1087, 1108, 1129, 1150, 1171, 1192, 1213, 1233, 1254, 1275,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 866,
		846, 825, 804, 784, 763, 743, 723, 703, 683, 663, 643, 624, 604, 585, 566, 547, 529, 510, 492, 474, 457, 439, 422, 405, 388, 372, 356, 340, 325, 309, 294, 280,
		265, 251, 238, 224, 211, 199, 186, 174, 163, 152, 141, 130,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 1003, 1024};
uint16_t poljeE[TonE] = {1024, 1046, 1069, 1091, 1113, 1135, 1158, 1180, 1202, 1224, 1246, 1267, 1289,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 1002, 1024};
uint16_t poljeF[TonF] = {1024, 1048, 1071, 1095, 1118, 1142, 1165, 1189, 1212, 1235, 1258, 1281, 1304,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 10,
		7, 4, 2, 1, 0, 0, 0, 1, 2, 4, 7, 10,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 1000, 1024};
uint16_t poljeFs[TonFs] = {1024, 1049, 1074, 1099, 1124, 1149, 1174, 1198, 1223, 1248, 1272, 1296, 1320,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 999, 1024};
uint16_t poljeG[TonG] = {1024, 1051, 1077, 1104, 1130, 1157, 1183, 1209, 1235, 1261, 1287, 1312, 1338,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 72,
		62, 53, 45, 38, 31, 25, 19, 15, 10, 7, 4, 2,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 997, 1024};
uint16_t poljeGs[TonGs] = {1024, 1053, 1081, 1110, 1138, 1167, 1195, 1223, 1251, 1279, 1306, 1334, 1361,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 399,
		377, 355, 334, 313, 292, 273, 254, 235, 217, 200, 183, 167,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 995, 1024};
uint16_t poljeA[TonA] = {1024, 1054, 1084, 1113, 1143, 1172, 1202, 1231, 1260, 1289, 1318, 1346, 1374,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 259,
		240, 221, 203, 185, 168, 152, 137, 123, 109, 96, 84, 72,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 96,
		109, 123, 137, 152, 168, 185, 203, 221, 240, 259, 279, 300, 321, 343, 366, 389, 413, 437, 461, 486, 512, 538, 564, 591, 618, 646, 674, 702, 730, 759, 788, 817,
		846, 876, 905, 935, 964, 994, 1024};
uint16_t poljeAs[TonAs] = {1024, 1056, 1087, 1118, 1150, 1181, 1212, 1243, 1274, 1304, 1334, 1364, 1394,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 992, 1024};
uint16_t poljeH[TonH] = {1024, 1058, 1091, 1124, 1158, 1191, 1224, 1257, 1289, 1321, 1353, 1385, 1416,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 990, 1024};


/* USER CODE END PV */

/* Private function prototypes -----------------------------------------------*/
void SystemClock_Config(void);
/* USER CODE BEGIN PFP */

/* USER CODE END PFP */

/* Private user code ---------------------------------------------------------*/
/* USER CODE BEGIN 0 */
void playTon(){
	uint16_t signal;
	int lenPolje = TonA;

	int i = 0;

	while (1) {
		// Ton
		signal = poljeA[i] * 2;
		// Sum
		//signal = rand ();
		HAL_I2S_Transmit (&hi2s3 , &signal , 1, 10) ;
		i++;

		if (i == lenPolje){
			i = 0;
		}
	}
}

void playTune(char c){
	uint16_t signal ;

	int i = 0;
	int duration = 0;
	uint16_t *polje;
	int lenPolje;

	if (c == 'a') { lenPolje = TonC; polje = poljeC;}
	else if(c == 'w') { lenPolje = TonCs; polje = poljeCs; }
	else if(c == 's') { lenPolje = TonD; polje = poljeD; }
	else if(c == 'e') { lenPolje = TonDs; polje = poljeDs; }
	else if(c == 'd') { lenPolje = TonE; polje = poljeE; }
	else if(c == 'f') { lenPolje = TonF; polje = poljeF; }
	else if(c == 't') { lenPolje = TonFs; polje = poljeFs; }
	else if(c == 'g') { lenPolje = TonG; polje = poljeG; }
	else if(c == 'z') { lenPolje = TonGs; polje = poljeGs; }
	else if(c == 'h') { lenPolje = TonA; polje = poljeA; }
	else if(c == 'u') { lenPolje = TonAs; polje = poljeAs; }
	else if(c == 'j') { lenPolje = TonH; polje = poljeH; }


	while(duration < LOOPNUM){
		// Ton
		signal = polje[i] * 2;
		// Sum
		//signal = rand ();
		HAL_I2S_Transmit (&hi2s3 , &signal , 1, 10) ;
		i++;

		if (i == lenPolje){
			i = 0;
			duration++;
		}
	}
	signal = 0;
}
int checkString(char c){
	int num = 12;
	for(int i = 0; i < num; i++){
		if(c == keys[i]){
			return 1;
		}
	}
	return 0;
}

int main ( void ) {
	char c;

	HAL_Init();
	SystemClock_Config();
	MX_GPIO_Init();
	MX_I2C1_Init ();
	MX_I2S3_Init ();

	MX_USART2_UART_Init ();

	configAudio ();


	while (1) {

		USART2_Dequeue (&c);

		if ( c != 0) {
			USART2_SendChar (c);
		}

//		if (c == 'a'){
//			playTon();
//		}
		// awsedftghuj
		if (checkString(c)){
			playTune(c);
		}
	}
}



/* USER CODE END 0 */

/**
  * @brief  The application entry point.
  * @retval int
  */

/**
  * @brief System Clock Configuration
  * @retval None
  */
void SystemClock_Config(void)
{
  RCC_OscInitTypeDef RCC_OscInitStruct = {0};
  RCC_ClkInitTypeDef RCC_ClkInitStruct = {0};

  /** Configure the main internal regulator output voltage
  */
  __HAL_RCC_PWR_CLK_ENABLE();
  __HAL_PWR_VOLTAGESCALING_CONFIG(PWR_REGULATOR_VOLTAGE_SCALE1);
  /** Initializes the RCC Oscillators according to the specified parameters
  * in the RCC_OscInitTypeDef structure.
  */
  RCC_OscInitStruct.OscillatorType = RCC_OSCILLATORTYPE_HSI;
  RCC_OscInitStruct.HSIState = RCC_HSI_ON;
  RCC_OscInitStruct.HSICalibrationValue = RCC_HSICALIBRATION_DEFAULT;
  RCC_OscInitStruct.PLL.PLLState = RCC_PLL_ON;
  RCC_OscInitStruct.PLL.PLLSource = RCC_PLLSOURCE_HSI;
  RCC_OscInitStruct.PLL.PLLM = 8;
  RCC_OscInitStruct.PLL.PLLN = 168;
  RCC_OscInitStruct.PLL.PLLP = RCC_PLLP_DIV2;
  RCC_OscInitStruct.PLL.PLLQ = 4;
  if (HAL_RCC_OscConfig(&RCC_OscInitStruct) != HAL_OK)
  {
    Error_Handler();
  }
  /** Initializes the CPU, AHB and APB buses clocks
  */
  RCC_ClkInitStruct.ClockType = RCC_CLOCKTYPE_HCLK|RCC_CLOCKTYPE_SYSCLK
                              |RCC_CLOCKTYPE_PCLK1|RCC_CLOCKTYPE_PCLK2;
  RCC_ClkInitStruct.SYSCLKSource = RCC_SYSCLKSOURCE_PLLCLK;
  RCC_ClkInitStruct.AHBCLKDivider = RCC_SYSCLK_DIV1;
  RCC_ClkInitStruct.APB1CLKDivider = RCC_HCLK_DIV4;
  RCC_ClkInitStruct.APB2CLKDivider = RCC_HCLK_DIV2;

  if (HAL_RCC_ClockConfig(&RCC_ClkInitStruct, FLASH_LATENCY_5) != HAL_OK)
  {
    Error_Handler();
  }
}

/* USER CODE BEGIN 4 */

/* USER CODE END 4 */

/**
  * @brief  This function is executed in case of error occurrence.
  * @retval None
  */
void Error_Handler(void)
{
  /* USER CODE BEGIN Error_Handler_Debug */
  /* User can add his own implementation to report the HAL error return state */
  __disable_irq();
  while (1)
  {
  }
  /* USER CODE END Error_Handler_Debug */
}

#ifdef  USE_FULL_ASSERT
/**
  * @brief  Reports the name of the source file and the source line number
  *         where the assert_param error has occurred.
  * @param  file: pointer to the source file name
  * @param  line: assert_param error line source number
  * @retval None
  */
void assert_failed(uint8_t *file, uint32_t line)
{
  /* USER CODE BEGIN 6 */
  /* User can add his own implementation to report the file name and line number,
     ex: printf("Wrong parameters value: file %s on line %d\r\n", file, line) */
  /* USER CODE END 6 */
}
#endif /* USE_FULL_ASSERT */

